## components/sdp/Kconfig
```kconfig
# Kconfig file for SDP v0.1.0


menu "SDP Configuration"

    config SDP_LOAD_BLE
        bool "Load Bluetooth Low Energy (BLE) libraries"
        help
            Set this option to tell SDP to load the Bluetooth library
            https://en.wikipedia.org/wiki/Bluetooth_Low_Energy

    rsource "ble/Kconfig"

    config SDP_LOAD_ESP_NOW
        bool "Load ESP-Now libraries"
        help
            Set this option to tell SDP to load the ESP-Now library
            https://www.espressif.com/en/products/software/esp-now/overview

    rsource "espnow/Kconfig"

    config SDP_LOAD_LORA
        bool "Load LoRa libraries"
        help
            Set this option to tell SDP to load the LoRa library
            https://en.wikipedia.org/wiki/LoRa
    
    rsource "lora/Kconfig"             
    
    config SDP_LOAD_I2C
        bool "Load I2C libraries"
        help
            Set this option to tell SDP to load the I2C wired library
            https://en.wikipedia.org/wiki/I%C2%B2C
        
    rsource "i2c/Kconfig" 

    config SDP_LOAD_UMTS
        bool "Load GSM/UMTS libraries"
        help
            Set this option to tell SDP to load the esp-modem GSM library

    rsource "gsm/Kconfig"

    config SDP_PEER_NAME_LEN
        int "Peer name length"
        default 16
        help
            The length of the sdp peer name. 

    config SDP_PEER_NAME
        string "The name of the peer"
        default "UNNAMEDPEER"
        help
            The name of the peer 
    config SDP_RECEIPT_TIMEOUT_MS
        int "How many milliseconds will SDP wait for a receipt?"
        default 100
        help
            When working synchronously an not broadcasting, SDP will wait for a short while until it gets a receipt from the receiver, saying that the CRC matched. 
            This indicates that the message was transmitted properly, and can then be reported back to the sending app, if needed.
            Usually, this is a quite the short time, as the receipt is just a few bytes and the receiver is supposed to do this immidiately, 
            but networking congestion or other things man cause the receiver to have to wait a little.
    config SDP_SIM
        bool "Run in simulation mode"
        help
            This causes the library to run in simulation mode, 
            it cause simulation settings to become visible.
            The mode is used to simulate and create problematic situations, 
            like glitching cables, radio interference or jamming (the bad kind)

endmenu
```

## components/sdp/lora/Kconfig
```kconfig
menu "Lora Config"
	depends on SDP_LOAD_LORA

	choice LORA_CHIP
		prompt "LoRa chip"
		default LORA_SX127X
		help 
			Select LoRa chip to use
		config LORA_SX127X
			bool "Semtech SX127x"
			help
				Semtech SX127x (without TCXO): https://github.com/nopnop2002/esp-idf-sx127x	
		config LORA_SX126X				
			bool "Semtech SX126x"
			help
				Semtech SX126x (with TCXO): https://github.com/nopnop2002/esp-idf-sx126x
	endchoice
	choice LORA_DIRECTION
		prompt "Communication polarity"
		default LORA_SENDER
		help
			Select Communication polarity.
		config LORA_SENDER
			bool "As the sender"
			help
				As the sender.
		config LORA_RECEIVER
			bool "As the receiver"
			help
				As the receiver.
	endchoice

	choice LORA_FREQUENCY
		prompt "Frequency to use"
		default LORA_FREQUENCY_433MHZ
		help
			Select Frequency to use.
		config LORA_FREQUENCY_169MHZ
			bool "169MHz"
			help
				Frequency is 169MHz.
		config LORA_FREQUENCY_433MHZ
			bool "433MHz"
			help
				Frequency is 433MHz.
		config LORA_FREQUENCY_470MHZ
			bool "470MHz"
			help
				Frequency is 470MHz.
		config LORA_FREQUENCY_866MHZ
			bool "866MHz"
			help
				Frequency is 866MHz.
		config LORA_FREQUENCY_915MHZ
			bool "915MHz"
			help
				Frequency is 915MHz.
		config LORA_FREQUENCY_OTHER
			bool "Other"
			help
				Other Frequency.
	endchoice

	config LORA_OTHER_FREQUENCY
		depends on LORA_FREQUENCY_OTHER
		int "Frequency to use[MHz]"
		range 1 999
		default 433
		help
			Frequency to use[MHz].

	config LORA_ADVANCED
		bool "Enable Advanced settings"
		default false
		help
			Enable Advanced settings.

	config LORA_CODING_RATE
		depends on LORA_ADVANCED
		int "Error coding rate"
		range 1 4
		default 1
		help
			Error coding rate.

	config LORA_BANDWIDTH
		depends on LORA_ADVANCED
		int "Signal Bandwidth"
		range 0 9
		default 7
		help
			Signal Bandwidth.

	config LORA_SF_RATE
		depends on LORA_ADVANCED
		int "Spreading Factor"
		range 5 12
		default 7
		help
			Spreading Factor.

	config LORA_GPIO_RANGE_MAX
		int
		default 33 if IDF_TARGET_ESP32
		default 46 if IDF_TARGET_ESP32S2
		default 19 if IDF_TARGET_ESP32C3
		default 48 if IDF_TARGET_ESP32S3

	config LORA_MISO_GPIO
		int "MISO GPIO"
		range 0 LORA_GPIO_RANGE_MAX
		default 19 if IDF_TARGET_ESP32
		default 37 if IDF_TARGET_ESP32S2
		default 37 if IDF_TARGET_ESP32S3
		default  4 if IDF_TARGET_ESP32C3
		help
			Pin Number to be used as the MISO SPI signal.

	config LORA_SCK_GPIO
		int "SCK GPIO"
		range 0 LORA_GPIO_RANGE_MAX
		default 18 if IDF_TARGET_ESP32
		default 36 if IDF_TARGET_ESP32S2
		default 36 if IDF_TARGET_ESP32S3
		default  5 if IDF_TARGET_ESP32C3
		help
			Pin Number to be used as the SCK SPI signal.

	config LORA_MOSI_GPIO
		int "MOSI GPIO"
		range 0 LORA_GPIO_RANGE_MAX
		default 23 if IDF_TARGET_ESP32
		default 35 if IDF_TARGET_ESP32S2
		default 35 if IDF_TARGET_ESP32S3
		default  6 if IDF_TARGET_ESP32C3
		help
			Pin Number to be used as the MOSI SPI signal.

	config LORA_CS_GPIO
		int "NSS GPIO"
		range 0 LORA_GPIO_RANGE_MAX
		default 15 if IDF_TARGET_ESP32
		default 34 if IDF_TARGET_ESP32S2
		default 34 if IDF_TARGET_ESP32S3
		default 7  if IDF_TARGET_ESP32C3
		help
			Pin Number where the NCS pin of the LoRa module is connected to.

	config LORA_RST_GPIO
		int "RST GPIO"
		range 0 LORA_GPIO_RANGE_MAX
		default 16 if IDF_TARGET_ESP32
		default 38 if IDF_TARGET_ESP32S2
		default 38 if IDF_TARGET_ESP32S3
		default 8  if IDF_TARGET_ESP32C3
		help
			Pin Number where the NRST pin of the LoRa module is connected to.

	choice LORA_SPI_HOST
		prompt "SPI peripheral that controls this bus"
		default LORA_SPI2_HOST
		help
			Select SPI peripheral that controls this bus.
		config LORA_SPI2_HOST
			bool "SPI2_HOST"
			help
				Use SPI2_HOST. This is also called HSPI_HOST.
		config LORA_SPI3_HOST
			depends on IDF_TARGET_ESP32 || IDF_TARGET_ESP32S2 || IDF_TARGET_ESP32S3
			bool "SPI3_HOST"
			help
				USE SPI3_HOST. This is also called VSPI_HOST
	endchoice
endmenu 
```
